## firmware/airplay-receiver/components/ipod_usb/Kconfig
```kconfig
menu "Volvo iPod USB device"

    config IPOD_USB_ENABLE
        bool "Enable iPod USB device (UAC1 + HID iAP)"
        default y
        help
            Present as an iPod (05AC:1261) with UAC1 audio streaming
            (device->host) and HID iAP transport. Takes over the native
            USB port (GPIO19/20); the USB-Serial/JTAG console goes quiet
            while enabled. Disable for AirPlay-only bench testing.

endmenu
```

## firmware/airplay-receiver/main/Kconfig.projbuild
```kconfig
menu "AirPlay iPod bridge identity"

    config ADAPTER_NAME
        string "AirPlay device name (shown on iPhone + car)"
        default "Volvo AirPlay"

    config ADAPTER_SSID
        string "Wi-Fi access point SSID"
        default "Volvo-AirPlay"

    config ADAPTER_PASSWORD
        string "Wi-Fi access point password (min 8 chars, empty = open)"
        default "volvoaudio"

    config ADAPTER_HOSTNAME
        string "mDNS hostname (without .local)"
        default "volvo-airplay"

endmenu
```

## firmware/airplay-receiver/sdkconfig.defaults
```kconfig
CONFIG_IDF_TARGET="esp32s3"
CONFIG_ESPTOOLPY_FLASHSIZE_16MB=y
CONFIG_PARTITION_TABLE_SINGLE_APP_LARGE=y
CONFIG_ESP_CONSOLE_USB_SERIAL_JTAG=y
CONFIG_ESP_DEFAULT_CPU_FREQ_MHZ_240=y
CONFIG_SPIRAM=y
CONFIG_SPIRAM_MODE_OCT=y
CONFIG_SPIRAM_SPEED_80M=y
CONFIG_SPIRAM_USE_MALLOC=y
CONFIG_SPIRAM_MALLOC_ALWAYSINTERNAL=16384
CONFIG_SPIRAM_ALLOW_STACK_EXTERNAL_MEMORY=y
CONFIG_LWIP_MAX_SOCKETS=16
CONFIG_ESP_MAIN_TASK_STACK_SIZE=8192
CONFIG_MBEDTLS_PEM_PARSE_C=y
CONFIG_MBEDTLS_PEM_WRITE_C=y
CONFIG_MBEDTLS_HARDWARE_MPI=y

CONFIG_FREERTOS_HZ=1000
```

## firmware/controller-probe/sdkconfig.defaults
```kconfig
CONFIG_BT_ENABLED=y
CONFIG_BT_CONTROLLER_ENABLED=y
CONFIG_BT_CONTROLLER_ONLY=y
CONFIG_ESP_CONSOLE_UART_DEFAULT=y
```
